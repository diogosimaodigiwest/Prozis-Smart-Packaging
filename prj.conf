## CMakeLists.txt
```
cmake_minimum_required(VERSION 3.20.0)


# Set the environment variable for UBXLIB_DIR
set(ENV{UBXLIB_DIR} ${CMAKE_CURRENT_LIST_DIR}/modules/ubxlib)

# Append the ubxlib module path to Zephyr modules
list(APPEND ZEPHYR_EXTRA_MODULES ${CMAKE_CURRENT_SOURCE_DIR}/modules/ubxlib)

# Set the configuration files early, before calling find_package(Zephyr ...)
set(CONF_FILE prj.conf ${CMAKE_CURRENT_LIST_DIR}/modules/ubxlib/port/platform/zephyr/default.conf)

# Now find Zephyr, as all required variables are set
find_package(Zephyr REQUIRED HINTS $ENV{ZEPHYR_BASE})


set(gen_dir ${CMAKE_CURRENT_BINARY_DIR}/certs)
zephyr_include_directories(${gen_dir})
generate_inc_file_for_target(
    app
    certs/AmazonRootCA1.pem
    ${gen_dir}/AmazonRootCA1.pem.inc
    )

include(${ZEPHYR_BASE}/samples/net/common/common.cmake)
include(${ZEPHYR_BASE}/samples/subsys/usb/common/common.cmake)

project(full-gateway-03)
target_include_directories(app PRIVATE ${CMAKE_SOURCE_DIR}/src)
FILE(GLOB app_sources src/*.c)
target_sources(app PRIVATE ${app_sources}
src/gateway_BLE/bleAdvConnCentral.c
src/gateway_BLE/blePAwRCentral.c
src/gateway_MODEM/gateway_modem.c 
src/gateway_STORAGE/gateway_storage.c 
src/gateway_STORAGE/nand_flash.c 
src/gateway_STORAGE/lfs.c 
src/gateway_STORAGE/lfs_util.c 
src/gateway_STORAGE/lfs_nand_wrapper.c)
```

## prj.conf
```kconfig
# Generic
CONFIG_LOG=y
CONFIG_DEBUG=y
CONFIG_CONSOLE=y
CONFIG_UART_INTERRUPT_DRIVEN=y
CONFIG_UART_ASYNC_API=y
CONFIG_SERIAL=y
CONFIG_SHELL=y
CONFIG_MAIN_STACK_SIZE=2048
CONFIG_LOG_PROCESS_THREAD_STACK_SIZE=1024
CONFIG_LOG_BUFFER_SIZE=2048
CONFIG_HEAP_MEM_POOL_SIZE=16384
# Winbond
CONFIG_SPI=y
# GNSS
CONFIG_UBXLIB=y
# Configuration
CONFIG_JSON_LIBRARY=y
```

## modem.conf
```kconfig
CONFIG_REQUIRES_FULL_LIBC=y
CONFIG_POSIX_API=y

# Networking config
CONFIG_NETWORKING=y
CONFIG_NET_NATIVE=y
CONFIG_NET_L2_PPP=y
CONFIG_NET_IPV4=y
CONFIG_NET_IPV6=y
CONFIG_NET_TCP=y
CONFIG_NET_SOCKETS=y
CONFIG_NET_CONTEXT_RCVTIMEO=y

# DNS
CONFIG_DNS_RESOLVER=y
CONFIG_NET_L2_PPP_OPTION_DNS_USE=y
CONFIG_NET_DHCPV4=y
CONFIG_DNS_SERVER1="8.8.8.8"

# Network management
CONFIG_NET_MGMT=y
CONFIG_NET_MGMT_EVENT=y
CONFIG_NET_CONNECTION_MANAGER=y

# Modem driver
CONFIG_MODEM=y
CONFIG_PM_DEVICE=y
CONFIG_MODEM_CELLULAR=y

# Network driver config
CONFIG_TEST_RANDOM_GENERATOR=n

# Network address config
CONFIG_NET_CONFIG_SETTINGS=y
CONFIG_NET_CONFIG_NEED_IPV4=y


# Network debug config
CONFIG_NET_LOG=n

# cellular auxiliary stuff
CONFIG_UART_ASYNC_API=y
CONFIG_MODEM_CELLULAR_APN="internetpm2m"
CONFIG_MODEM_CELLULAR_CMUX_MAX_FRAME_SIZE=2048
CONFIG_MODEM_MODULES_LOG_LEVEL_DBG=n

# -------------TLS------------- #

CONFIG_HTTP_CLIENT=y

# TFM configuration
CONFIG_TFM_PROFILE_TYPE_NOT_SET=y

# MbedTLS and security
CONFIG_MBEDTLS=y
CONFIG_NET_SOCKETS_SOCKOPT_TLS=y
CONFIG_MBEDTLS_ENABLE_HEAP=y
CONFIG_MBEDTLS_SSL_IN_CONTENT_LEN=8192
CONFIG_MBEDTLS_SSL_OUT_CONTENT_LEN=8192
CONFIG_MBEDTLS_HEAP_SIZE=50000
CONFIG_MBEDTLS_TLS_LIBRARY=y
CONFIG_MBEDTLS_X509_LIBRARY=y
CONFIG_MBEDTLS_PKCS1_V15=y
CONFIG_NRF_SECURITY_ADVANCED=y
CONFIG_NORDIC_SECURITY_BACKEND=y
CONFIG_PSA_CRYPTO_DRIVER_CC3XX=y
CONFIG_PSA_WANT_ALG_RSA_PKCS1V15_CRYPT=y
CONFIG_PSA_WANT_ALG_RSA_PKCS1V15_SIGN=y
CONFIG_PSA_WANT_KEY_TYPE_RSA_PUBLIC_KEY=y

# Enable RSA, ECDSA and ECDHE (Elliptic curve algorithms)
CONFIG_MBEDTLS_ECP_C=y
CONFIG_MBEDTLS_ECDSA_C=y
CONFIG_MBEDTLS_ECDH_C=y
CONFIG_MBEDTLS_RSA_C=y

# Crypto Magic
CONFIG_MBEDTLS_ECP_DP_SECP521R1_ENABLED=y
CONFIG_MBEDTLS_ECP_DP_BP384R1_ENABLED=y
CONFIG_MBEDTLS_ECP_DP_BP512R1_ENABLED=y
CONFIG_MBEDTLS_SERVER_NAME_INDICATION=y
CONFIG_NET_SOCKETS_TLS_MAX_CONTEXTS=4
# CONFIG_TLS_CREDENTIAL_FILENAMES=y
CONFIG_MBEDTLS_KEY_EXCHANGE_RSA_ENABLED=y
CONFIG_MBEDTLS_SHA256_C=y
CONFIG_MBEDTLS_SHA384_C=y
CONFIG_MBEDTLS_AES_C=y
CONFIG_MBEDTLS_ENTROPY_C=y

# mbedTLS debuggers
CONFIG_MBEDTLS_DEBUG=y
CONFIG_MBEDTLS_DEBUG_C=y
CONFIG_NET_SOCKETS_LOG_LEVEL_DBG=n

# RSA requires that at least one key size is enabled
CONFIG_PSA_WANT_RSA_KEY_SIZE_2048=y
CONFIG_PSA_WANT_RSA_KEY_SIZE_4096=y

# Modem key management needs to be set to n, if not the certificate are provisioned to the modem
CONFIG_MODEM_KEY_MGMT=n
```

## pawr.conf
```kconfig
# BLE
CONFIG_BT=y
CONFIG_BT_BROADCASTER=y
CONFIG_BT_EXT_ADV=y
CONFIG_BT_PER_ADV=y
CONFIG_BT_DEVICE_NAME="PAwR conn sample"
# Needs PAST tag even tough no PAST is used, zephyr stuff I guess
CONFIG_BT_PER_ADV_SYNC_TRANSFER_SENDER=y
CONFIG_BT_PER_ADV_RSP=y
CONFIG_BT_MAX_CONN=1
CONFIG_BT_CENTRAL=y
CONFIG_BT_GATT_CLIENT=y
CONFIG_BT_PRIVACY=y
CONFIG_BT_SMP=y
```

## src/gateway.h
```c
#include <zephyr/kernel.h>
#include <zephyr/drivers/gpio.h>
#include <zephyr/drivers/spi.h>
#include <zephyr/drivers/uart.h>

#pragma once

/**
 * @brief Structures for LittleFS Data Storage and Processing
 *
 * This set of structures is designed to handle and store and move data to
 * the LittleFS file system. It supports multiple data types (GNSS, Sensor, and Impact)
 * unified under the `SaveData` structure for streamlined processing.
 * The 'MetaData' structure holds information about ongoing operations or potential
 * configurations regarding operation methods.
 */

/**
 * @brief Stores GNSS (Global Navigation Satellite System) data.
 *
 * Fields:
 * - `latitude`  (int32_t): Latitude in degrees scaled by 10^7, providing high precision.
 * - `longitude` (int32_t): Longitude in degrees scaled by 10^7.
 * - `radius`    (int32_t): Radial accuracy of the measurement in millimeters.
 * - `utc`       (int64_t): UTC timestamp as a 64-bit integer.
 */
typedef struct
{
    int32_t latitude;
    int32_t longitude;
    int32_t radius;
    int64_t utc;

} GnssData;

/**
 * @brief Holds data captured from a BLE sensor.
 *
 * Fields:
 * - `ID`           (uint32_t): Unique identifier for the sensor.
 * - `timestamp`    (uint64_t): Timestamp of the measurement.
 * - `temperature`  (uint16_t): Temperature reading (unit and scaling to be defined).
 * - `humidity`     (uint16_t): Humidity reading (percentage or other unit).
 * - `pressure`     (uint16_t): Atmospheric pressure (unit to be defined).
 */
typedef struct
{
    uint32_t ID;
    uint64_t timestamp;
    uint16_t temperature;
    uint16_t humidity;
    uint16_t pressure;
} SensorData;

/**
 * @brief Captures data related to an impact event.
 *
 * Fields:
 * - `ID`               (uint32_t): Unique identifier for the impact event.
 * - `impact_timestamp` (uint64_t): Timestamp of the impact.
 * - `impact_force`     (uint16_t): Impact force value.
 */
typedef struct
{
    uint32_t ID;
    uint64_t impact_timestamp;
    uint16_t impact_force;
} ImpactData;

/**
 * @brief Enum defining the types of packages supported.
 *
 * Values:
 * - `PACKAGE_TYPE_BLE_SENSOR` (0): BLE Sensor data.
 * - `PACKAGE_TYPE_BLE_IMPACT` (1): BLE Impact data.
 * - `PACKAGE_TYPE_GNSS`       (2): GNSS data.
 * - `PACKAGE_TYPE_COUNT`      (3): End of types.
 */
typedef enum uint8_t
{
    PACKAGE_TYPE_BLE_SENSOR,
    PACKAGE_TYPE_BLE_IMPACT,
    PACKAGE_TYPE_GNSS,
    PACKAGE_TYPE_COUNT
} PackageType;

/**
 * @brief Union to hold any of the supported data types (Sensor, Impact, GNSS).
 *
 * Fields:
 * - `sensor` (SensorData): BLE Sensor data.
 * - `impact` (ImpactData): BLE Impact data.
 * - `gnss`   (GnssData): GNSS data.
 */
typedef union
{
    SensorData sensor;
    ImpactData impact;
    GnssData gnss;
} PackageData;

/**
 * @brief Unified structure to store data for LittleFS operations.
 *
 * Fields:
 * - `type` (PackageType): The type of package.
 * - `data` (PackageData): The actual data corresponding to the type.
 */
typedef struct
{
    PackageType type;
    PackageData data;
} SaveData;

/**
 * @brief Stores metadata about `SaveData` packages for each LittleFS session file.
 *
 * This structure holds essential metadata for managing session files containing
 * `SaveData` packages, such as GNSS, sensor, or impact data. It tracks the file's
 * transmission state, size, and other configuration or status flags.
 *
 * Fields:
 * - `session`   (int32_t): The session in which there are files left to be transmitted.
 * - `type`   (PackageType): The type of package (e.g., GNSS, sensor, or impact).
 * - `count`   (int32_t): The total number of bytes that have been transmitted from the file.
 * - `sent`   (int32_t): The total size of the file in bytes.
 */
typedef struct
{
    int32_t session;
    PackageType type;
    int32_t count;
    int32_t sent;
} MetaData;

/**
 * @brief Configuration structure for gateway operation parameters.
 *
 * This structure defines adjustable parameters that control the behavior
 * of the gateway's main operational threads. By modifying these values,
 * the system can dynamically adjust sleep intervals to optimize power
 * consumption, communication frequency, and overall performance.
 *
 * Fields:
 * - `gnss_sleep_ms`  (int): Time in milliseconds that the GNSS thread sleeps between operations.
 * - `modem_sleep_ms` (int): Time in milliseconds that the modem thread sleeps between transmissions.
 */
typedef struct
{
    int gnss_sleep_ms;  // Sleep time for GNSS thread
    int modem_sleep_ms; // Sleep time for Modem thread
} GwCfg;

#define USE_GNSS_TEST 1     // Fully tested
#define USE_LFS_TEST 0      // Fully tested
#define USE_BLE_TEST 0      // Fully tested - not working on ns build
#define USE_CELLULAR_TEST 1 // Fully tested
#define USE_COMS_TEST 1     // Fully tested (can have more work delegated to)
#define USE_MY_TEST 1       // For auxiliary testing

/* Priorities, stack sizes, message queue sizes, thread delays */
#define THREAD_PRIORITY 5 // The lower the number the higher the priority
#define HIGH_PRIORITY 1
#define LOW_PRIORITY 9
#define MY_STACK_SIZE 4096
#define GNSS_STACK_SIZE 4096
#define COMS_STACK_SIZE 1024
#define MODEM_STACK_SIZE 8192
#define BLE_STACK_SIZE 1024
#define LFS_STACK_SIZE 8192
/* Sleep/delays on boot */
#define MY_THREAD_DELAY_MS 120000
#define GNSS_THREAD_DELAY_MS 60000
#define CELLULAR_THREAD_DELAY_MS 30000
#define LFS_THREAD_DELAY_MS 500
#define COMS_THREAD_DELAY_MS 1000
#define BLE_THREAD_DELAY_MS 2000

/* Message Queues*/
#define GNSS_QUEUE_SIZE 4
#define MODEM_QUEUE_SIZE 4
#define BLE_QUEUE_SIZE 20
#define IMPACT_QUEUE_SIZE 20
#define SAVE_DATA_QUEUE_SIZE 80 // 4 times the maximum SaveData structures to send via modem per loop

void extract_http_body(const char *response, void *gw_config_ptr); // JSON parser
```
